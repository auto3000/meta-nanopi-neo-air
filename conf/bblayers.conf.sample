## conf/bblayers.conf.sample
```bitbake
# LAYER_CONF_VERSION is increased each time build/conf/bblayers.conf
# changes incompatibly
LCONF_VERSION = "6"

BBPATH = "${TOPDIR}"
BBFILES ?= ""
BBLAYERS ?= " \
  ##COREBASE##/meta \
  ##COREBASE##/meta-yocto \
  ##COREBASE##/../meta-openembedded/meta-oe \
  ##COREBASE##/../meta-openembedded/meta-networking \
  ##COREBASE##/../meta-openembedded/meta-python \
  ##COREBASE##/../meta-nanopi-neo-air \
  ##COREBASE##/../meta-sunxi \
  "

BBMASK = ""
```

## conf/layer.conf
```bitbake
# We have a conf directory, append to BBPATH
BBPATH .= ":${LAYERDIR}"

# We have a recipes directory, add to BBFILES
BBFILES += "${LAYERDIR}/recipes*/*/*.bb \
            ${LAYERDIR}/recipes*/*/*.bbappend"

BBFILE_COLLECTIONS += "meta-nanopi-neo-air"
BBFILE_PATTERN_meta-nanopi-neo-air := "^${LAYERDIR}/"
BBFILE_PRIORITY_meta-nanopi-neo-air = "8"
```

## conf/machine/nanopi-neo-air.conf
```bitbake
#@TYPE: Machine
#@NAME: nanopi-neo
#@DESCRIPTION: Machine configuration for the FriendlyARM NanoPi Neo, based on the Allwinner H3 CPU

require conf/machine/include/sun8i.inc

PREFERRED_PROVIDER_virtual/kernel = "linux-armbian"
PREFERRED_VERSION_linux = "4.11"
PREFERRED_VERSION_u-boot = "friendlyarm"

KERNEL_DEVICETREE = "sun8i-h3-nanopi-neo-air.dtb"
UBOOT_MACHINE = "nanopi_neo_air_defconfig"

DEFAULTTUNE = "cortexa7hf-neon-vfpv4"

MACHINE_EXTRA_RRECOMMENDS += " kernel-modules linux-firmware-bcm43430 "
```

## conf/machine/nanopi-neo.conf
```bitbake
#@TYPE: Machine
#@NAME: nanopi-neo
#@DESCRIPTION: Machine configuration for the FriendlyARM NanoPi Neo, based on the Allwinner H3 CPU

require conf/machine/include/sun8i.inc

PREFERRED_PROVIDER_virtual/kernel = "linux-omega"
PREFERRED_VERSION_linux = "4.10.1"
PREFERRED_VERSION_u-boot = "v2016.11%"

KERNEL_DEVICETREE = "sun8i-h3-nanopi-neo.dtb"
UBOOT_MACHINE = "nanopi_neo_defconfig"

DEFAULTTUNE = "cortexa7hf-neon-vfpv4"

MACHINE_EXTRA_RRECOMMENDS += " kernel-modules linux-firmware-brcm43438"
MACHINE_FEATURES += "wifi"
```
